## Kconfig
```kconfig
menu "Tiny Font Options"

    choice

        prompt "Font System"
        default TINYFONT_IBMF

        config TINYFONT_IBMF
            bool "IBMF 1bpp Sol Sans Font"

        config TINYFONT_TTF
            bool "TTF Font via FreeType"

    endchoice

    config TINYFONT_DISPLAY_DPI
        int "Screen resolution per inch (for TTF sizing)"
        depends on TINYFONT_TTF
        default 150

    config TINYFONT_USE_SPIRAM
        bool "Use SPIRAM heap when possible"
        default y

    config TINYFONT_PIXEL_RESOLUTION_IS_FIX
        bool "Display pixel resolution is unchangeable at runtime."
        default y

    choice

        prompt "Default pixel resolution"
        default TINYFONT_PIXEL_RESOLUTION_ONE_BIT if TINYFONT_IBMF
        default TINYFONT_PIXEL_RESOLUTION_EIGHT_BIT if TINYFONT_TTF

        config TINYFONT_PIXEL_RESOLUTION_ONE_BIT
        bool "1 bit per pixel"

        config TINYFONT_PIXEL_RESOLUTION_EIGHT_BIT
        depends on TINYFONT_TTF
        bool "8 bits per pixel"

        config TINYFONT_PIXEL_RESOLUTION_SIXTEEN_BIT
        depends on TINYFONT_TTF
        bool "16 bits per pixel"

        config TINYFONT_PIXEL_RESOLUTION_TWENTY_FOUR_BIT
        depends on TINYFONT_TTF
        bool "24 bits per pixel"

    endchoice

endmenu
```
